## config/west.yml
```yaml
manifest:
  remotes:
    - name: travdev
      url-base: https://github.com/TravDev/zmk-config-totem
  projects:
    - name: zmk
      remote: zmkfirmware
      revision: main
      import: app/west.yml
  self:
    path: config
```
